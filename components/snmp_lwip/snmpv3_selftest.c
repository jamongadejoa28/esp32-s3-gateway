/* On-target known-answer self-test of the lwIP SNMPv3 crypto hooks (contract: snmp_lwip/snmpv3_util.h).
 *
 * Exercises the real device backend (snmpv3_psa.c on PSA / ESP hardware AES+SHA) through the same
 * entry points lwIP uses while processing an authPriv message: snmpv3_auth() over a pbuf chain,
 * snmpv3_crypt() in place over a pbuf chain (with the RFC 3826 IV built from boots/time/salt), and the
 * RFC 3414 A.2 password-to-key functions. Every vector below is recomputed independently on the host
 * by tests/test_snmp_crypto_kat.py (Python hmac/hashlib/cryptography), so a wrong constant here fails
 * the host tests. Message/plaintext bytes are generated by formula (KAT_MSG / KAT_PT) to keep the
 * file small; the host test uses the same formulas. */
#include <string.h>

#include "lwip/apps/snmp_opts.h"

#if LWIP_SNMP && LWIP_SNMP_V3 && LWIP_SNMP_V3_CRYPTO && !LWIP_SNMP_V3_MBEDTLS

#include "esp_log.h"
#include "lwip/pbuf.h"
#include "snmp_lwip/snmpv3_util.h"
#include "snmp_pbuf_stream.h"
#include "snmpv3_priv.h"

static const char *TAG = "snmpv3_kat";

/* RFC 3414 A.3.1 / A.3.2: "maplesyrup" localized for engine 00 00 00 00 00 00 00 00 00 00 00 02. */
static const uint8_t KAT_ENGINE_ID[12] = {0, 0, 0, 0, 0, 0, 0, 0, 0, 0, 0, 2};
static const char KAT_PASSWORD[] = "maplesyrup";
static const uint8_t KAT_KEY_MD5[16] = {0x52, 0x6f, 0x5e, 0xed, 0x9f, 0xcc, 0xe2, 0x6f,
                                        0x89, 0x64, 0xc2, 0x93, 0x07, 0x87, 0xd8, 0x2b};
static const uint8_t KAT_KEY_SHA[20] = {0x66, 0x95, 0xfe, 0xbc, 0x92, 0x88, 0xe3, 0x62, 0x82, 0x23,
                                        0x5f, 0xc7, 0x15, 0x1f, 0x12, 0x84, 0x97, 0xb3, 0x8f, 0x3f};

/* HMAC over KAT_MSG_LEN bytes msg[i] = (i * 7 + 3) & 0xff, split 61 + 89 over two pbufs. */
#define KAT_MSG_LEN 150
#define KAT_MSG_SPLIT 61
#define KAT_MSG(i) ((uint8_t)(((i) * 7 + 3) & 0xff))
static const uint8_t KAT_HMAC_SHA[20] = {0x55, 0x04, 0x2f, 0xd6, 0x11, 0xbc, 0xe0, 0xd6, 0xb1, 0x3a,
                                         0x4b, 0xbd, 0x68, 0x2f, 0xa9, 0xd7, 0x2b, 0x4f, 0x7a, 0xef};
static const uint8_t KAT_HMAC_MD5[16] = {0x61, 0x9f, 0x03, 0x04, 0x95, 0xfb, 0x1d, 0x3a,
                                         0xee, 0xde, 0x5e, 0x28, 0xd1, 0x75, 0x7e, 0x16};

/* AES-128-CFB (RFC 3826): key = first 16 octets of KAT_KEY_SHA, boots 7, time 123456, salt below,
 * plaintext pt[i] = (i * 13 + 5) & 0xff, 100 bytes split 37 + 63 (a 64-byte chunk crosses the pbufs). */
#define KAT_PT_LEN 100
#define KAT_PT_SPLIT 37
#define KAT_PT(i) ((uint8_t)(((i) * 13 + 5) & 0xff))
#define KAT_BOOTS 7u
#define KAT_TIME 123456u
static const uint8_t KAT_SALT[8] = {0xa1, 0xa2, 0xa3, 0xa4, 0xa5, 0xa6, 0xa7, 0xa8};
static const uint8_t KAT_CT[KAT_PT_LEN] = {
    0x73, 0x40, 0x68, 0x9e, 0xce, 0xc5, 0x11, 0x18, 0x9f, 0x57, 0x1d, 0x32, 0xf7, 0x04, 0xe9, 0x2e, 0xc0,
    0x75, 0xd8, 0xd7, 0xbc, 0xec, 0x38, 0x60, 0x35, 0xb6, 0x55, 0x4b, 0x02, 0x4d, 0x40, 0x0e, 0x31, 0xfe,
    0xce, 0xff, 0xde, 0x26, 0xb9, 0x04, 0x27, 0x71, 0x7e, 0xf5, 0xeb, 0xbe, 0x0e, 0xe8, 0x98, 0x24, 0x1e,
    0x25, 0xae, 0x21, 0xb3, 0x05, 0xf6, 0x46, 0xae, 0x9c, 0x80, 0xe6, 0x18, 0x4a, 0x8d, 0x56, 0xa5, 0x03,
    0x4a, 0xf7, 0xf8, 0x07, 0x0b, 0xb8, 0x78, 0xda, 0x8c, 0xaf, 0x97, 0xca, 0xa7, 0xee, 0x63, 0xcf, 0x83,
    0xc2, 0xfd, 0x6d, 0x03, 0x91, 0x98, 0x55, 0x15, 0x4f, 0x7e, 0x24, 0x59, 0x1e, 0xda, 0x0c};

/* Two-pbuf chain of total `len` bytes split at `split`, or NULL. */
static struct pbuf *chain_alloc(u16_t len, u16_t split) {
    struct pbuf *a = pbuf_alloc(PBUF_RAW, split, PBUF_RAM);
    struct pbuf *b = pbuf_alloc(PBUF_RAW, (u16_t)(len - split), PBUF_RAM);
    if (a == NULL || b == NULL) {
        if (a != NULL) {
            pbuf_free(a);
        }
        if (b != NULL) {
            pbuf_free(b);
        }
        return NULL;
    }
    pbuf_cat(a, b);
    return a;
}

static int check(bool ok, const char *what) {
    if (!ok) {
        ESP_LOGE(TAG, "FAIL: %s", what);
        return 1;
    }
    ESP_LOGD(TAG, "ok: %s", what);
    return 0;
}

static int kat_auth(void) {
    int fails = 0;
    struct pbuf *p = chain_alloc(KAT_MSG_LEN, KAT_MSG_SPLIT);
    if (p == NULL) {
        return check(false, "auth: pbuf alloc");
    }
    for (u16_t i = 0; i < KAT_MSG_LEN; i++) {
        (void)pbuf_put_at(p, i, KAT_MSG(i));
    }
    u8_t mac[SNMP_V3_SHA_LEN];
    struct snmp_pbuf_stream s;

    memset(mac, 0, sizeof(mac));
    snmp_pbuf_stream_init(&s, p, 0, KAT_MSG_LEN);
    fails += check(snmpv3_auth(&s, KAT_MSG_LEN, KAT_KEY_SHA, SNMP_V3_AUTH_ALGO_SHA, mac) == ERR_OK &&
                       memcmp(mac, KAT_HMAC_SHA, sizeof(KAT_HMAC_SHA)) == 0,
                   "HMAC-SHA-96 over a pbuf chain");
    fails += check(s.offset == 0 && s.length == KAT_MSG_LEN, "snmpv3_auth leaves the caller's stream untouched");

    memset(mac, 0, sizeof(mac));
    snmp_pbuf_stream_init(&s, p, 0, KAT_MSG_LEN);
    fails += check(snmpv3_auth(&s, KAT_MSG_LEN, KAT_KEY_MD5, SNMP_V3_AUTH_ALGO_MD5, mac) == ERR_OK &&
                       memcmp(mac, KAT_HMAC_MD5, sizeof(KAT_HMAC_MD5)) == 0,
                   "HMAC-MD5-96 over a pbuf chain");

    snmp_pbuf_stream_init(&s, p, 0, KAT_MSG_LEN);
    fails += check(snmpv3_auth(&s, KAT_MSG_LEN, KAT_KEY_SHA, SNMP_V3_AUTH_ALGO_INVAL, mac) == ERR_ARG,
                   "invalid auth algorithm -> ERR_ARG");
    pbuf_free(p);
    return fails;
}

static int kat_priv(void) {
    int fails = 0;
    struct pbuf *p = chain_alloc(KAT_PT_LEN, KAT_PT_SPLIT);
    if (p == NULL) {
        return check(false, "priv: pbuf alloc");
    }
    for (u16_t i = 0; i < KAT_PT_LEN; i++) {
        (void)pbuf_put_at(p, i, KAT_PT(i));
    }
    u8_t buf[KAT_PT_LEN];
    struct snmp_pbuf_stream s;

    snmp_pbuf_stream_init(&s, p, 0, KAT_PT_LEN);
    err_t e = snmpv3_crypt(&s, KAT_PT_LEN, KAT_KEY_SHA, KAT_SALT, KAT_BOOTS, KAT_TIME, SNMP_V3_PRIV_ALGO_AES,
                           SNMP_V3_PRIV_MODE_ENCRYPT);
    fails += check(e == ERR_OK && pbuf_copy_partial(p, buf, KAT_PT_LEN, 0) == KAT_PT_LEN &&
                       memcmp(buf, KAT_CT, KAT_PT_LEN) == 0,
                   "AES-128-CFB encrypt in place (RFC 3826 IV)");

    snmp_pbuf_stream_init(&s, p, 0, KAT_PT_LEN);
    e = snmpv3_crypt(&s, KAT_PT_LEN, KAT_KEY_SHA, KAT_SALT, KAT_BOOTS, KAT_TIME, SNMP_V3_PRIV_ALGO_AES,
                     SNMP_V3_PRIV_MODE_DECRYPT);
    bool same = (e == ERR_OK && pbuf_copy_partial(p, buf, KAT_PT_LEN, 0) == KAT_PT_LEN);
    for (u16_t i = 0; same && i < KAT_PT_LEN; i++) {
        same = (buf[i] == KAT_PT(i));
    }
    fails += check(same, "AES-128-CFB decrypt restores the plaintext");

    snmp_pbuf_stream_init(&s, p, 0, KAT_PT_LEN);
    fails += check(snmpv3_crypt(&s, KAT_PT_LEN, KAT_KEY_SHA, KAT_SALT, KAT_BOOTS, KAT_TIME, SNMP_V3_PRIV_ALGO_DES,
                                SNMP_V3_PRIV_MODE_DECRYPT) == ERR_ARG,
                   "DES -> ERR_ARG");
    pbuf_free(p);
    return fails;
}

static int kat_password_to_key(void) {
    int fails = 0;
    u8_t key[SNMP_V3_SHA_LEN];
    snmpv3_password_to_key_sha((const u8_t *)KAT_PASSWORD, strlen(KAT_PASSWORD), KAT_ENGINE_ID,
                               (u8_t)sizeof(KAT_ENGINE_ID), key);
    fails += check(memcmp(key, KAT_KEY_SHA, sizeof(KAT_KEY_SHA)) == 0, "RFC 3414 A.3.2 SHA key localization");
    snmpv3_password_to_key_md5((const u8_t *)KAT_PASSWORD, strlen(KAT_PASSWORD), KAT_ENGINE_ID,
                               (u8_t)sizeof(KAT_ENGINE_ID), key);
    fails += check(memcmp(key, KAT_KEY_MD5, sizeof(KAT_KEY_MD5)) == 0, "RFC 3414 A.3.1 MD5 key localization");
    return fails;
}

int snmpv3_selftest(void) {
    int fails = kat_auth() + kat_priv() + kat_password_to_key();
    if (fails == 0) {
        ESP_LOGI(TAG, "SNMPv3 crypto self-test passed (HMAC-SHA/MD5-96, AES-128-CFB, RFC 3414 A.3)");
    } else {
        ESP_LOGE(TAG, "SNMPv3 crypto self-test: %d check(s) FAILED", fails);
    }
    return fails;
}

#else /* SNMPv3 crypto not configured */

#include "snmp_lwip/snmpv3_util.h"

int snmpv3_selftest(void) {
    return 0;
}

#endif
